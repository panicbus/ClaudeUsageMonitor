## firmware/main/Kconfig.projbuild
```kconfig
menu "Claude Usage Monitor Configuration"

# Don't set real values via menuconfig - put them in
# firmware/sdkconfig.defaults.local (gitignored). Start from
# firmware/sdkconfig.defaults.local.example.

config WIFI_SSID
    string "WiFi SSID"
    default ""
    help
        SSID of the WiFi network to connect to.

config WIFI_PASSWORD
    string "WiFi Password"
    default ""
    help
        WPA2 password for the WiFi network above.

config WIFI_SSID_2
    string "Fallback WiFi SSID (optional)"
    default ""
    help
        A second trusted network, e.g. a phone's personal hotspot. The
        device scans on every connection attempt and always prefers
        WIFI_SSID above when it's in range, only using this one when
        WIFI_SSID isn't visible. Leave blank to disable.

config WIFI_PASSWORD_2
    string "Fallback WiFi Password (optional)"
    default ""
    help
        WPA2 password for WIFI_SSID_2 above.

config WIFI_SSID_3
    string "Second fallback WiFi SSID (optional)"
    default ""
    help
        A third trusted network, tried only when neither WIFI_SSID nor
        WIFI_SSID_2 is in range - e.g. a travel router, an office network,
        or a second phone's hotspot. Leave blank to disable.

config WIFI_PASSWORD_3
    string "Second fallback WiFi Password (optional)"
    default ""
    help
        WPA2 password for WIFI_SSID_3 above.

config USAGE_SERVICE_URL
    string "Usage service URL"
    default ""
    help
        Full URL of the claude-usage-monitor service's /usage endpoint.
        Use the dev machine's mDNS/Bonjour hostname (e.g.
        "http://my-mac.local:4317/usage"), not a raw LAN IP - the IP
        changes whenever DHCP reassigns it, which silently breaks polling
        until someone notices and reflashes. The hostname survives that.

endmenu
```
